## arch/riscv/cpu/eic7700/Kconfig
```kconfig
# SPDX-License-Identifier: GPL-2.0-only
#
# Copyright 2024 Beijing ESWIN Computing Technology Co., Ltd.

config EIC7700_RISCV
	bool
	select BINMAN if SPL
	select ARCH_EARLY_INIT_R
	select SYS_CACHE_SHIFT_6
	imply CPU
	imply CPU_RISCV
	imply RISCV_TIMER if (RISCV_SMODE || SPL_RISCV_SMODE)
	imply RISCV_ACLINT if RISCV_MMODE
	imply SPL_RISCV_ACLINT if SPL_RISCV_MMODE
	imply CMD_CPU
	imply SPL_CPU
	imply SPL_OPENSBI
	imply SPL_LOAD_FIT
```

## board/eswin/eic7700_evb/Kconfig
```kconfig
if TARGET_ESWIN_EVB_EIC7700
config SYS_BOARD
	default "eic7700_evb"

config SYS_VENDOR
	default "eswin"

config SYS_CPU
	default "eic7700"

config SYS_CONFIG_NAME
	default "eswin_eic7700_evb"

config TEXT_BASE
	default 0x80200000 if SPL
	default 0x80000000 if !RISCV_SMODE
	default 0x80200000 if RISCV_SMODE

config SPL_TEXT_BASE
	default 0x08000000

config SPL_OPENSBI_LOAD_ADDR
	default 0x80000000

config BOARD_SPECIFIC_OPTIONS # dummy
	def_bool y
	select EIC7700_RISCV
	select BOARD_LATE_INIT
	imply CMD_DHCP
	imply CMD_EXT2
	imply CMD_EXT4
	imply CMD_FAT
	imply CMD_FS_GENERIC
	imply CMD_NET
	imply CMD_PING
	imply CMD_MMC

config BR2_EXTRA_ENV
	string "user custom environment setting"
config BOOT_NFS
	int "user launch sel"
	default "0"

config ROOTFS_NFS_PATH
	string "user custom environment setting : nfs rootfs path"
config TFTP_SERVERIP
	string "user custom environment setting : tftp server ip"

endif
```

## configs/hifive_premier_p550_defconfig
```kconfig
CONFIG_RISCV=y
CONFIG_SYS_MALLOC_LEN=0x10000000
CONFIG_NR_DRAM_BANKS=1
CONFIG_HAS_CUSTOM_SYS_INIT_SP_ADDR=y
CONFIG_CUSTOM_SYS_INIT_SP_ADDR=0xf0000000
CONFIG_ENV_SIZE=0x80000
CONFIG_ENV_OFFSET=0xd80000
CONFIG_DM_GPIO=y
CONFIG_DEFAULT_DEVICE_TREE="hifive-premier-p550"
CONFIG_OF_LIBFDT_OVERLAY=y
CONFIG_DM_RESET=y
CONFIG_SYS_LOAD_ADDR=0x80200000
CONFIG_PCI=y
CONFIG_AHCI=y
CONFIG_TARGET_HIFIVE_PREMIER_P550=y
CONFIG_ARCH_RV64I=y
CONFIG_RISCV_SMODE=y
CONFIG_SHOW_REGS=y
CONFIG_FIT=y
CONFIG_DISTRO_DEFAULTS=y
CONFIG_USE_PREBOOT=y
CONFIG_PREBOOT="setenv fdt_addr ${fdtcontroladdr};fdt addr ${fdtcontroladdr};usb start"
CONFIG_DISPLAY_CPUINFO=y
CONFIG_DISPLAY_BOARDINFO=y
CONFIG_MISC_INIT_R=y
CONFIG_SYSTEM_UPDATE_A=y
CONFIG_CMD_SBI=y
CONFIG_SYS_BOOTM_LEN=0x04000000
CONFIG_CMD_ERASEENV=y
CONFIG_CMD_NVEDIT_EFI=y
CONFIG_CMD_GPIO=y
CONFIG_CMD_LED=y
CONFIG_CMD_GPT=y
CONFIG_CMD_I2C=y
CONFIG_CMD_ESFS=y
CONFIG_CMD_ESWOTP=y
CONFIG_CMD_LSBLK=y
CONFIG_CMD_MTD=y
CONFIG_CMD_PCI=y
CONFIG_CMD_SATA=y
CONFIG_CMD_SF_TEST=y
CONFIG_CMD_SPI=y
CONFIG_CMD_USB=y
CONFIG_CMD_TFTPPUT=y
CONFIG_CMD_TFTPSRV=y
CONFIG_CMD_EFIDEBUG=y
CONFIG_CMD_EXT4_WRITE=y
CONFIG_OF_LIVE=y
CONFIG_ENV_IS_IN_SPI_FLASH=y
CONFIG_SYS_RELOC_GD_ENV_ADDR=y
CONFIG_NET_RANDOM_ETHADDR=y
CONFIG_REGMAP=y
CONFIG_SYSCON=y
CONFIG_DWC_AHSATA_ESWIN=y
CONFIG_SYS_64BIT_LBA=y
CONFIG_CLK_ESWIN=y
CONFIG_CLK_ESWIN_EIC770x=y
CONFIG_USB_FUNCTION_FASTBOOT=y
CONFIG_UDP_FUNCTION_FASTBOOT=y
CONFIG_FASTBOOT_BUF_ADDR=0x90000000
CONFIG_FASTBOOT_BUF_SIZE=0x10000000
CONFIG_FASTBOOT_FLASH=y
CONFIG_FASTBOOT_FLASH_MMC_DEV=0
CONFIG_ESWIN_GPIO=y
CONFIG_DM_I2C=y
CONFIG_SYS_I2C_DW=y
CONFIG_DM_MAILBOX=y
CONFIG_ESWIN_UMBOX=y
CONFIG_MISC=y
CONFIG_I2C_EEPROM=y
CONFIG_MMC=y
CONFIG_MMC_IO_VOLTAGE=y
CONFIG_MMC_UHS_SUPPORT=y
CONFIG_MMC_SDHCI=y
CONFIG_MMC_SDHCI_SD_ESWIN=y
CONFIG_SPI_FLASH_WINBOND=y
CONFIG_DWC_ETH_ESWIN=y
CONFIG_NVME_PCI=y
CONFIG_PCIE_DW_ESWIN=y
CONFIG_PINCTRL=y
CONFIG_PINCONF=y
CONFIG_RESET_ESWIN=y
CONFIG_ESWIN_UART_SYNOPSYS=y
CONFIG_SPI=y
CONFIG_DESIGNWARE_SPI=y
CONFIG_ESWIN_SPI=y
CONFIG_USB=y
CONFIG_DM_USB_GADGET=y
CONFIG_USB_XHCI_HCD=y
CONFIG_USB_XHCI_DWC3=y
CONFIG_USB_XHCI_ESWIN=y
CONFIG_USB_EHCI_HCD=y
CONFIG_USB_OHCI_HCD=y
CONFIG_USB_UHCI_HCD=y
CONFIG_USB_DWC3=y
CONFIG_USB_DWC3_GENERIC=y
CONFIG_USB_DWC3_ESWIN=y
CONFIG_USB_KEYBOARD=y
CONFIG_USB_GADGET=y
CONFIG_USB_GADGET_VENDOR_NUM=0x3452
CONFIG_USB_GADGET_PRODUCT_NUM=0x7700
CONFIG_VIDEO=y
CONFIG_SYS_WHITE_ON_BLACK=y
CONFIG_DISPLAY=y
CONFIG_DRM_ESWIN=y
CONFIG_DRM_ESWIN_DW_HDMI=y
CONFIG_DRM_ESWIN_DW_MIPI_DSI=y
CONFIG_BMP_24BPP=y
CONFIG_LED=y
CONFIG_LED_GPIO=y
```

## drivers/clk/eswin/Kconfig
```kconfig
# SPDX-License-Identifier: GPL-2.0-only
#
# Copyright 2024 Beijing ESWIN Computing Technology Co., Ltd.

config CLK_ESWIN
	bool "Eswin SoC driver support"
	depends on CLK
	help
	  SoC drivers for Eswin Linux-capable SoCs.

config CLK_ESWIN_EIC770x
	bool "Clock driver for ESWIN EIC770x SoCs"
	depends on CLK_ESWIN
	help
	  Supports the Clock interface IP block found in
	  EIC770x SoCs.  If this kernel is meant to run on a Eswin EIC770x SoC,
	  enable this driver.
```

## drivers/display_logo/Kconfig
```kconfig
# SPDX-License-Identifier: GPL-2.0-only
#
# Copyright 2024 Beijing ESWIN Computing Technology Co., Ltd.

menu "Display Logo Support"

config CONFIG_MINI_GRAPHIC_LIBRARY
	bool "Enable eswin display logo support"
	default n
	help
	  This enables eswin display logo support. 

endmenu
```

## drivers/mini_graphic_library/Kconfig
```kconfig
# SPDX-License-Identifier: GPL-2.0-only
#
# Copyright 2024 Beijing ESWIN Computing Technology Co., Ltd.

#
# Video configuration
#

menu "Mini Graphic Library Support"

config CONFIG_MINI_GRAPHIC_LIBRARY
	bool "Enable eswin mini graphic library support"
	default n
	help
	  This enables eswin mini graphic library support. 

endmenu
```

## drivers/video/eswin/Kconfig
```kconfig
menuconfig DRM_ESWIN
	bool "Eswin DRM Support"
	depends on VIDEO && OF_LIVE
	select VIDEO_BRIDGE
	select PHY
	help
	  Eswin SoCs provide video output capabilities for High-Definition
	  Multimedia Interface (HDMI) and Display Serial Interface (DSI).

	  This driver supports the on-chip video output device, and targets the
	  Eswin fu800.

config DRM_ESWIN_WRITEBACK
    bool "Eswin DC8000 Writeback Support"
    depends on DRM_ESWIN
    help
     This selects support for Eswin SoC specific extensions
     for the DC8000 writeback. If you want to
     enable DC8000 writeback, you should selet this option.

config DRM_ESWIN_DW_HDMI
	bool "Eswin DW HDMI Support"
	depends on DRM_ESWIN
	help
	 This selects support for Eswin SoC specific extensions
	 for the Synopsys DesignWare HDMI driver. If you want to
	 enable HDMI on, you should selet this option.

config DRM_ESWIN_DW_MIPI_DSI
	tristate "Eswin DW MIPI DSI Support"
	depends on DRM_ESWIN
	select DRM_MIPI_DSI
	select DRM_ESWIN_PANEL
	help
	 This selects support for Eswin SoC specific extensions
	 for the Synopsys DesignWare HDMI driver. If you want to
	 enable MIPI DSI on fu800 based SoC, you should selet this
	 option.

config DRM_ESWIN_PANEL
	bool "Eswin 1080x1920 4-lanes Panel Support"
	depends on DRM_ESWIN_DW_MIPI_DSI
	select DRM_MIPI_DSI

config DRM_ESWIN_RGB
	bool "Eswin RGB Support"
	depends on DRM_ESWIN
	select DRM_ESWIN_PANEL
	help
	  Choose this option to enable support for Eswin RGB driver.
	  say Y to enable its driver.

config ESWIN_LOGO_DISPLAY
	bool "Display ESWIN logo instead of vidconsole"
	depends on DRM_ESWIN
	help
	  Choose this option to display ESWIN logo instead of
	  vidconsole even if the stdout been set to vidconsole.
	  say Y to enable it.
```
