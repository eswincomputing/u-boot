## board/eswin/vpu7702_pcie/Kconfig
```kconfig
if TARGET_ESWIN_VPU7702_PCIE
config SYS_BOARD
	default "vpu7702_pcie"

config SYS_VENDOR
	default "eswin"

config SYS_CPU
	default "eic770x"

config SYS_CONFIG_NAME
	default "eswin_vpu7702_pcie"

config TEXT_BASE
	default 0x80200000 if SPL
	default 0x80000000 if !RISCV_SMODE
	default 0x80200000 if RISCV_SMODE

config SPL_TEXT_BASE
	default 0x08000000

config SPL_OPENSBI_LOAD_ADDR
	default 0x80000000

config BOARD_SPECIFIC_OPTIONS # dummy
	def_bool y
	select EIC770X_RISCV
	select BOARD_LATE_INIT
	imply CMD_DHCP

config BR2_EXTRA_ENV
	string "user custom environment setting"
config BOOT_NFS
	int "user launch sel"
	default "0"

config ROOTFS_NFS_PATH
	string "user custom environment setting : nfs rootfs path"
config TFTP_SERVERIP
	string "user custom environment setting : tftp server ip"

endif
```

## configs/ebc7702_u01_pcie_defconfig
```kconfig
CONFIG_RISCV=y
CONFIG_SYS_MALLOC_LEN=0x10000000
CONFIG_NR_DRAM_BANKS=2
CONFIG_HAS_CUSTOM_SYS_INIT_SP_ADDR=y
CONFIG_CUSTOM_SYS_INIT_SP_ADDR=0xf0000000
CONFIG_ENV_SIZE=0x80000
CONFIG_ENV_OFFSET=0xf00000
CONFIG_BOARD_INFO_OFFSET=0xf80000
CONFIG_DM_GPIO=y
CONFIG_DEFAULT_DEVICE_TREE="ebc7702-u01-pcie"
CONFIG_OF_LIBFDT_OVERLAY=y
CONFIG_DM_RESET=y
CONFIG_SYS_LOAD_ADDR=0x80200000
CONFIG_PCI=y
CONFIG_AHCI=y
CONFIG_TARGET_ESWIN_EBC7702_U01_PCIE=y
CONFIG_ARCH_RV64I=y
CONFIG_RISCV_SMODE=y
CONFIG_SHOW_REGS=y
CONFIG_FIT=y
CONFIG_BOOTSTD_FULL=y
CONFIG_BOOTSTD_DEFAULTS=y
CONFIG_DISTRO_DEFAULTS=y
CONFIG_OF_BOARD_SETUP=y
CONFIG_BOOT_ESWIN_VPU7702=y
CONFIG_USE_PREBOOT=y
CONFIG_CMD_SN_UPDATE=y
CONFIG_DISPLAY_CPUINFO=y
CONFIG_DISPLAY_BOARDINFO=y
CONFIG_MISC_INIT_R=y
CONFIG_CMD_BMP=y
CONFIG_CMD_SBI=y
CONFIG_SYS_BOOTM_LEN=0x20000000
CONFIG_CMD_ERASEENV=y
CONFIG_CMD_GPIO=y
CONFIG_CMD_I2C=y
CONFIG_CMD_ESFS=y
CONFIG_CMD_ES_MKFSFAT=y
CONFIG_CMD_ESWOTP=y
CONFIG_CMD_LSBLK=y
CONFIG_CMD_MTD=y
CONFIG_CMD_PCI=y
CONFIG_CMD_POWEROFF=y
# CONFIG_CMD_SATA is not set
CONFIG_CMD_SF_TEST=y
CONFIG_CMD_SPI=y
CONFIG_CMD_USB=y
CONFIG_CMD_TFTPPUT=y
CONFIG_CMD_TFTPSRV=y
CONFIG_CMD_EXT4_WRITE=y
CONFIG_OF_LIVE=y
CONFIG_OF_BOARD=y
CONFIG_SYS_RELOC_GD_ENV_ADDR=y
CONFIG_NET_RANDOM_ETHADDR=y
CONFIG_REGMAP=y
CONFIG_SYSCON=y
CONFIG_DWC_AHSATA_ESWIN=y
CONFIG_SYS_64BIT_LBA=y
CONFIG_CLK_ESWIN=y
CONFIG_CLK_ESWIN_EIC770x=y
CONFIG_USB_FUNCTION_FASTBOOT=y
CONFIG_UDP_FUNCTION_FASTBOOT=y
CONFIG_FASTBOOT_BUF_ADDR=0x90000000
CONFIG_FASTBOOT_BUF_SIZE=0x10000000
CONFIG_FASTBOOT_FLASH=y
CONFIG_FASTBOOT_FLASH_MMC_DEV=0
CONFIG_ESWIN_GPIO=y
CONFIG_DM_I2C=y
CONFIG_SYS_I2C_DW=y
CONFIG_LED=y
CONFIG_LED_GPIO=y
CONFIG_DM_MAILBOX=y
CONFIG_ESWIN_UMBOX=y
CONFIG_MISC=y
CONFIG_I2C_EEPROM=y
# CONFIG_MMC_IO_VOLTAGE is not set
CONFIG_MMC=y
# CONFIG_MMC_UHS_SUPPORT is not set
# CONFIG_MMC_HS400_SUPPORT is not set
# CONFIG_MMC_SDHCI is not set
# CONFIG_MMC_SDHCI_SDMA is not set
# CONFIG_MMC_SDHCI_SD_ESWIN is not set
CONFIG_SPI_FLASH_WINBOND=y
# CONFIG_DWC_ETH_ESWIN is not set
# CONFIG_NVME_PCI is not set
# CONFIG_PCIE_DW_ESWIN is not set
CONFIG_PINCTRL=y
CONFIG_PINCONF=y
CONFIG_RESET_ESWIN=y
CONFIG_DM_RTC=y
CONFIG_RTC_PCF8563=y
CONFIG_ESWIN_UART_SYNOPSYS=y
CONFIG_SPI=y
CONFIG_DESIGNWARE_SPI=y
CONFIG_ESWIN_SPI=y
CONFIG_SYSRESET=y
# CONFIG_USB is not set
# CONFIG_VIDEO is not set
# CONFIG_SYS_WHITE_ON_BLACK is not set
# CONFIG_DISPLAY is not set
# CONFIG_DRM_ESWIN is not set
# CONFIG_DRM_ESWIN_DW_HDMI is not set
# CONFIG_DRM_ESWIN_DW_MIPI_DSI is not set
# CONFIG_SPLASH_SCREEN is not set
# CONFIG_SPLASH_SCREEN_ALIGN is not set
# CONFIG_HIDE_LOGO_VERSION is not set
# CONFIG_VIDEO_LOGO is not set
# CONFIG_BMP is not set
# CONFIG_BMP_24BPP is not set
# CONFIG_USB_HUB_DEBOUNCE_TIMEOUT is not set
# CONFIG_EFI_LOADER is not set
# CONFIG_NET is not set
CONFIG_CMD_D2D=y
```
